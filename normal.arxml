AUTOSAR XML
4 x :
  ContainerF  # ZZ
  ContainerA  # BB
  ContainerC  # CC
  ContainerB  # AA
